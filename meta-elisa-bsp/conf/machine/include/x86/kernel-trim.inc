## meta-elisa-bsp/meta-elisa-bsp-qemu/conf/layer.conf
```bitbake
# We have a conf and classes directory, add to BBPATH
BBPATH .= ":${LAYERDIR}"

# We have recipes-* directories, add to BBFILES
BBFILES += "${LAYERDIR}/recipes-*/*/*.bb \
            ${LAYERDIR}/recipes-*/*/*.bbappend"

BBFILE_COLLECTIONS += "elisabsp"
BBFILE_PATTERN_elisabsp= "^${LAYERDIR}/"
BBFILE_PRIORITY_elisabsp= "30"

LAYERDEPENDS_elisabsp = "core"
LAYERSERIES_COMPAT_elisabsp = "kirkstone"
```

## meta-elisa-core/conf/layer.conf
```bitbake
# We have a conf and classes directory, add to BBPATH
BBPATH .= ":${LAYERDIR}"

# We have recipes-* directories, add to BBFILES
BBFILES += "${LAYERDIR}/recipes-*/*/*.bb \
            ${LAYERDIR}/recipes-*/*/*.bbappend"

BBFILE_COLLECTIONS += "elisacore"
BBFILE_PATTERN_elisacore = "^${LAYERDIR}/"
BBFILE_PRIORITY_elisacore = "30"

LAYERDEPENDS_elisacore = "core"
LAYERSERIES_COMPAT_elisacore = "kirkstone"
```
